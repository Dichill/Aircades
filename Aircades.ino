#include <Wire.h>
#include <SPI.h>
#include <stdint.h>
#include <Adafruit_Sensor.h>
#include <Adafruit_BMP280.h>
#define BMP_SCK 13
#define BMP_MISO 12
#define BMP_MOSI 11
#define BMP_CS 10

Adafruit_BMP280 bmp;

#include "U8glib.h"

U8GLIB_SSD1306_128X64 u8g(U8G_I2C_OPT_NO_ACK); 

float pressure;
float temp;

const uint8_t storm[] PROGMEM= {

0x00, 0x00, 0x00, 0x00, 0x00, 0x00, 0x00, 0x00, 0x00, 0xFE, 0x00, 0x00, 0x00, 0x00, 0x01, 0xFF,
0x80, 0x00, 0x00, 0x00, 0x07, 0x01, 0xC0, 0x00, 0x00, 0x00, 0x0E, 0x00, 0x60, 0x00, 0x00, 0x00,
0x0C, 0x00, 0x60, 0x00, 0x00, 0x00, 0x18, 0x00, 0x30, 0x00, 0x00, 0x00, 0x18, 0x00, 0x18, 0x00,
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0x00, 0x00, 0x00, 0x00, 0x00, 0x00, 0x00, 0x00, 0x00, 0x00, 0x00, 0x00, 0x00, 0x00, 0x00, 0x00

};

const uint8_t rain[] PROGMEM = {

0x00, 0x00, 0x00, 0x00, 0x00, 0x00, 0x00, 0x00, 0x00, 0x00, 0x00, 0x00, 0x00, 0x00, 0x00, 0x00,
0x00, 0x00, 0x00, 0x00, 0x00, 0x00, 0x00, 0x00, 0x00, 0x00, 0x00, 0x00, 0x00, 0x00, 0x00, 0x00,
0x00, 0x00, 0x00, 0x00, 0x00, 0x00, 0x07, 0xF0, 0x00, 0x00, 0x00, 0x00, 0x1C, 0x18, 0x00, 0x00,
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0x00, 0x00, 0x00, 0x00, 0x00, 0x00, 0x00, 0x00, 0x00, 0x00, 0x00, 0x00, 0x00, 0x00, 0x00, 0x00
};

const uint8_t presure[] PROGMEM = {
0x00, 0x00, 0x00, 0x00, 0x00, 0x00, 0x00, 0x00, 0x00, 0x00, 0x00, 0x00, 0x00, 0x00, 0x00, 0x00,
0x00, 0x00, 0x00, 0x00, 0x00, 0x00, 0x00, 0x00, 0x00, 0x00, 0x00, 0x00, 0x00, 0x00, 0x00, 0x00,
0x0F, 0xF0, 0x00, 0x00, 0x00, 0x00, 0xFF, 0xFF, 0x00, 0x00, 0x00, 0x03, 0xFF, 0xFF, 0xC0, 0x00,
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0x00, 0x00, 0x00, 0x00, 0x00, 0x00, 0x00, 0x00, 0x00, 0x00, 0x00, 0x00, 0x00, 0x00, 0x00, 0x00
};

const uint8_t temperature[] PROGMEM = {

0x00, 0x00, 0x1F, 0x80, 0x00, 0x00, 0x00, 0x00, 0x7F, 0xC0, 0x00, 0x00, 0x00, 0x00, 0xF9, 0xE0,
0x00, 0x00, 0x00, 0x01, 0xE0, 0x70, 0x00, 0x00, 0x00, 0x01, 0xC0, 0x70, 0x00, 0x00, 0x00, 0x03,
0x80, 0x39, 0xFC, 0x00, 0x00, 0x03, 0x80, 0x39, 0xFC, 0x00, 0x00, 0x03, 0x80, 0x38, 0x00, 0x00,
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0xF1, 0xF8, 0x00, 0x00, 0x00, 0x00, 0xFF, 0xE0, 0x00, 0x00, 0x00, 0x00, 0x3F, 0x80, 0x00, 0x00

};

const uint8_t intro[] PROGMEM = {
0x0, 0x0, 0x0, 0x0, 0x0, 0x0, 0x0, 0x0, 0x0, 0x0, 0x0, 0x0, 0x0, 0x0, 0x0, 
0x0, 0x0, 0x0, 0x0, 0x0, 0x0, 0x0, 0x0, 0x0, 0x0, 0x0, 0x0, 0x0, 0x0, 0x0, 
0x0, 0x0, 0x0, 0x0, 0x0, 0x0, 0x0, 0x0, 0x0, 0x0, 0x0, 0x0, 0x0, 0x0, 0x0, 
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0x0, 0x0, 0x0, 0x0

};

const uint8_t sunny[] PROGMEM = {
0x00, 0x00, 0x00, 0x00, 0x00, 0x00, 0x00, 0x00, 0x00, 0x00, 0x00, 0x00, 0x00, 0x00, 0x00, 0x00,
0x00, 0x00, 0x00, 0x00, 0x00, 0x00, 0x00, 0x00, 0x00, 0x00, 0x00, 0x00, 0x00, 0x00, 0x00, 0x00,
0x00, 0x00, 0x00, 0x00, 0x00, 0x00, 0x00, 0x00, 0x00, 0x00, 0x00, 0x00, 0x00, 0x00, 0x00, 0x00,
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0x00, 0x00, 0x00, 0x00, 0x00, 0x00, 0x00, 0x00, 0x00, 0x00, 0x00, 0x00, 0x00, 0x00, 0x00, 0x00

};

const uint8_t cloudy[] PROGMEM= {

0x00, 0x00, 0x00, 0x00, 0x00, 0x00, 0x00, 0x00, 0x00, 0x00, 0x00, 0x00, 0x00, 0x00, 0x00, 0x00,
0x00, 0x00, 0x00, 0x00, 0x00, 0x00, 0x00, 0x00, 0x00, 0x00, 0x00, 0x00, 0x00, 0x00, 0x00, 0x00,
0x00, 0x00, 0x00, 0x00, 0x00, 0x00, 0x00, 0x08, 0x00, 0x00, 0x00, 0x00, 0x02, 0x08, 0x40, 0x00,
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0x00, 0x00, 0x00, 0x00, 0x00, 0x00, 0x00, 0x00, 0x00, 0x00, 0x00, 0x00, 0x00, 0x00, 0x00, 0x00

};

void draw(void) {
  u8g.setFont(u8g_font_8x13);
  u8g.setPrintPos(0,10);
  u8g.print("Forum");

  u8g.drawBitmapP( 0, 20, 16, 64,intro);
}

void drawpressure(void){
  pressure = bmp.readPressure()/100;
  delay(1);
  u8g.setPrintPos(0,10);
  u8g.print("Pressure");
  u8g.setPrintPos(64,45);
  u8g.print(pressure);
  u8g.setPrintPos(70,60);
  u8g.print("p");
  u8g.drawBitmapP( 0, 15, 6, 48,presure);
}

void drawtemperature(void){
  u8g.setFont(u8g_font_8x13);
  u8g.setPrintPos(0,10);
  u8g.print("Temperature");

  u8g.setPrintPos(55, 40);
  u8g.print(temp);
  u8g.setPrintPos(97,40);
  u8g.print("C");
  u8g.drawBitmapP( 0, 17, 6,48,temperature);
}

void drawaltitude(void) {
  u8g.setFont(u8g_font_8x13);
  u8g.setPrintPos(0,10);
  u8g.print("Altitude");

  u8g.setPrintPos(55, 40);
  u8g.print(bmp.readAltitude(1010));
  u8g.setPrintPos(97,40);
  u8g.print("Agl");
  u8g.drawBitmapP(0,17,6,48,temperature);
}

void drawforecast(void){
  u8g.setPrintPos(3,10);
  u8g.print("Weather Forecast");

  if ((pressure<1006.59)&&(pressure>1006.51)){
  u8g.drawBitmapP( 10, 15, 6, 48,cloudy);
  u8g.setPrintPos(60,45);
  u8g.print("Cloudy");
  }

  // 1006.29 1005.20
  // 1006.59 1006.51
  
  else if((pressure<1006.29)&&(pressure>1005.20))
  {
  u8g.drawBitmapP( 10, 15, 6, 48,rain);
  u8g.setPrintPos(66,38);
  u8g.print("Rain");}
  else if((pressure>1006.60)&&(pressure<1050))
  {
  u8g.drawBitmapP( 5, 15, 6, 48,sunny);
  u8g.setPrintPos(50,45);
  u8g.print("Clear Sky");}
  else if((pressure>1006.30)&&(pressure<=1006.50))
  {
  u8g.drawBitmapP( 5, 15, 6, 48,storm);
  u8g.setPrintPos(60,45);
  u8g.print("Storm");}
  else{
  u8g.setPrintPos(40,40);
  u8g.print("Error");
  }
}


String inputString = "";
boolean stringComplete = false;
String commandString = "";
boolean isConnected = false;

void setup() {
  // put your setup code here, to run once:
  Serial.begin(9600);
  pinMode(LED_BUILTIN, OUTPUT);
  
  if(!bmp.begin()){
    u8g.print("[Drx] Cannot find Sensor");
  }
    /* Default settings from datasheet. */
  bmp.setSampling(Adafruit_BMP280::MODE_NORMAL,     /* Operating Mode. */
                  Adafruit_BMP280::SAMPLING_X2,     /* Temp. oversampling */
                  Adafruit_BMP280::SAMPLING_X16,    /* Pressure oversampling */
                  Adafruit_BMP280::FILTER_X16,      /* Filtering. */
                  Adafruit_BMP280::STANDBY_MS_500); /* Standby time. */

  u8g.firstPage();
  do {
    draw();
  }
  while(u8g.nextPage());
  delay(2000);
}

void loop() {
  // put your main code here, to run repeatedly:
  Serial.print(bmp.readTemperature()); // Temp
  Serial.print(",");
  //Serial.print(bmp.readHumidity()); // Humidity
  Serial.print(pressure); // Pressure
  Serial.print(",");
  Serial.print(bmp.readAltitude(1010)); // Altitude
  Serial.print(",");

  // Via by Observation and Analysis. The pressure has been set via Observation of pressure and the weather allowing
  // AIRCADES to predict the weather.
  if ((pressure<1006.51)&&(pressure>1006.60)){
  Serial.print("Cloudy");
  }
  else if((pressure<1006.29)&&(pressure>1005.20))
  {
  Serial.print("Rain");
  }
  else if((pressure>1006.61)&&(pressure<1050))
  {
  Serial.print("Clear Sky");
  }
  else if((pressure>1006.30)&&(pressure<=1006.50))
  {
  Serial.print("Storm");
  }
  else{
  Serial.print("Error");
  }
  Serial.print(",");
  Serial.print("8b04d5e3775d298e78455efc5ca404d5"); // Product Number
  Serial.println();
  temp = bmp.readTemperature();
  u8g.firstPage();
  do {
    drawpressure();
  }
  while (u8g.nextPage());
  delay(2000);
  u8g.firstPage();
  do {
    drawtemperature();
  }
  while(u8g.nextPage());
  delay(2000);
  u8g.firstPage();
  do {
    drawforecast();
  }
  while(u8g.nextPage());
  delay(2000);
  u8g.firstPage();
  do {
    drawaltitude();
  }
  while(u8g.nextPage());
  delay(2000);
  
  
  if (stringComplete){
    stringComplete = false;
    getCommand();

    if(commandString.equals("LEDHIGH"))
    {
      digitalWrite(LED_BUILTIN, HIGH);
      delay(10000);
    }    
    if(commandString.equals("STOP"))
    {
      digitalWrite(LED_BUILTIN, LOW);
    }
    if(commandString.equals("Temp"))
    {
      drawtemperature();
    }
    if(commandString.equals("Pressure"))
    {
      drawpressure();
    }
    if(commandString.equals("Altitude"))
    {
      drawaltitude();
    }
    if(commandString.equals("Weather"))
    {
      drawforecast();
    }
  



    
    inputString = "";
  }
 
}

String getTextToPrint()
{
  String value = inputString.substring(5,inputString.length()-2);
  return value;
}

void printText(String text)
{
  
}

void flash(int duration)
{
  digitalWrite(LED_BUILTIN, HIGH);
  delay(duration);
  digitalWrite(LED_BUILTIN, LOW);
  delay(duration);
}

void getCommand()
{
  if(inputString.length()>0)
  {
    commandString = inputString.substring(1,5);
  }
}

void serialEvent()
{
  while(Serial.available()) {
    char inChar = (char)Serial.read();
    inputString += inChar;
    if (inChar == '\n') {
      stringComplete = true;
    }
  }
}

// Draxeous - Dichill
